## drivers/soc/qcom/samsung/Kconfig
```kconfig
# When adding new entries keep the list in alphabetical order

config SEC_THERMISTOR
	bool "Use external thermistor near AP for checking temprature"
	default n
	help
	  Use thermistor driver for checking temperature near AP chip.

config SEC_USE_FLASH_THERMISTOR
	depends on SEC_THERMISTOR
	bool "Use external thermistor near flash for checking temprature"
	default n
	help
	  Use thermistor driver for checking temperature near flash led.
```
